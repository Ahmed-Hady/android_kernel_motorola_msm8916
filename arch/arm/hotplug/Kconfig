## arch/arm/hotplug/Kconfig
```kconfig
config CLUSTER_PLUG
        bool "Enable cluster-plug cpu hotplug driver"
        default n
        help
          CPU hotplug driver designed for ARM big.LITTLE systems where
          both the big and little CPUs are of the same type. On these
          systems, it preferable to normall use the big cluster, and
          only activate the little cluster for highly parallel loads.
          This hotplug implementation always keeps the big cluster
          online, and only activates the little cluster for heavy
          parallel loads.

config BRICKED_HOTPLUG
 	bool "Enable kernel based mpdecision"
 	depends on MSM_RUN_QUEUE_STATS
 	default y
 	help
 	  This enables kernel based multi core control. 

config ALUCARD_HOTPLUG
	bool "Enable alucard-hotplug cpu hotplug driver"
 	default y
 	help
 	  Generic Alucard-hotplug cpu hotplug driver for ARM SOCs

config MSM_SLEEPER
 	bool "CPU hotplug driver"
 	default n
 	help
 	  CPU hotplug driver

config INTELLI_PLUG
 	bool "Hotplug for Razor Reborn"
 	depends on MSM_RUN_QUEUE_STATS
 	default y
 	help
 	  This enables kernel based multi core control.
```
